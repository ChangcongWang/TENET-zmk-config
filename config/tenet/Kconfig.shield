## config/tenet/Kconfig.shield
```kconfig
# Copyright (c) 2025 WCC
# SPDX-License-Identifier: MIT

config SHIELD_TENET_LEFT
    def_bool $(shields_list_contains,tenet_left)

config SHIELD_TENET_RIGHT
    def_bool $(shields_list_contains,tenet_right)
```
